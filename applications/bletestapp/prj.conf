## CMakeLists.txt
```
# Copyright (C) 2026 Alif Semiconductor - All Rights Reserved.
# Use, distribution and modification of this code is permitted under the
# terms stated in the Alif Semiconductor Software License Agreement
#
# You should have received a copy of the Alif Semiconductor Software
# License Agreement with this file. If not, please write to:
# contact@alifsemi.com, or visit: https://alifsemi.com/license

cmake_minimum_required(VERSION 3.20.0)
find_package(Zephyr REQUIRED HINTS $ENV{ZEPHYR_BASE})
project(ble_testapp)

include(${CMAKE_CURRENT_SOURCE_DIR}/../../samples/bluetooth/common/CMakeLists.txt)

# Include directories
target_include_directories(app PRIVATE
	${COMMON_INC}
)

target_sources(app PRIVATE
    src/main.c
    src/appl_shell.c
    src/power_mgr.c
    src/ble_handler.c
    src/power_shell.c
    ${COMMON_SRCS}
)
```

## prj.conf
```kconfig
# Copyright (C) Alif Semiconductor - All Rights Reserved.
# Use, distribution and modification of this code is permitted under the
# terms stated in the Alif Semiconductor Software License Agreement
#
# You should have received a copy of the Alif Semiconductor Software
# License Agreement with this file. If not, please write to:
# contact@alifsemi.com, or visit: https://alifsemi.com/license

CONFIG_BT=y
CONFIG_BT_CUSTOM=y
CONFIG_ASSERT=y
CONFIG_IDLE_STACK_SIZE=2048
CONFIG_PM=y
CONFIG_PM_DEVICE=y
CONFIG_POWER_DOMAIN=y
CONFIG_COUNTER=y

CONFIG_COUNTER_RTC_SNPS_DW=y
CONFIG_ALIF_POWER_MGR_LIB=n
CONFIG_ALIF_POWER_MGR_SHELL=n

CONFIG_PM_DEVICE=y
CONFIG_POWER_DOMAIN=y
CONFIG_PM_S2RAM=y
CONFIG_PM_SAU_SAVE_RESTORE=y

CONFIG_SYS_CLOCK_TICKS_PER_SEC=1000
CONFIG_STDOUT_CONSOLE=y
CONFIG_PRINTK=y
CONFIG_POWEROFF=y
CONFIG_BOOT_BANNER=n

CONFIG_SHELL=y
CONFIG_SHELL_AUTOSTART=n
CONFIG_ALIF_TESTCOMMANDS_SHELL=y

CONFIG_LOG=y
CONFIG_LOG_MODE_MINIMAL=y
# CONFIG_LOG_MODE_IMMEDIATE=y
# application logging level
CONFIG_MAIN_LOG_LEVEL_INF=y

# reduce log max level to info
CONFIG_LOG_MAX_LEVEL=3

CONFIG_ALIF_PM_SLEEP_ENABLE=1

####### Configuration supported with the upddated Secure Enclave software
CONFIG_ALIF_EXT_WAKEUP_TIME=0
CONFIG_ALIF_OSC_WAKEUP_TIME=1700
CONFIG_ALIF_RM_WAKEUP_TIME=0
CONFIG_ALIF_EXT_WARMBOOT_WAKEUP_TIME=1700
CONFIG_SE_SERVICE_INIT_PRIORITY=1
CONFIG_KERNEL_INIT_PRIORITY_DEFAULT=0
CONFIG_GPIO_INIT_PRIORITY=40

CONFIG_ALIF_MAX_SLEEP_CLOCK_DRIFT=252
CONFIG_ALIF_MAX_ACTIVE_CLOCK_DRIFT=252

CONFIG_DATA_STRING_LENGTH=243
CONFIG_CORTEX_M_SYSTICK_LPM_TIMER_HOOKS=y

# Increase shell max commands so that we can set run_cfg and off_cfg
CONFIG_SHELL_ARGC_MAX=32
CONFIG_SHELL_CMD_BUFF_SIZE=384
```

## src/ble_handler.c
```c
#include "ble_handler.h"

#include <errno.h>
#include <zephyr/kernel.h>
#include <zephyr/logging/log.h>

#include <se_service.h>
#include "alif_ble.h"
#include "gapm.h"
#include "gap_le.h"
#include "gapc_le.h"
#include "gapc_sec.h"
#include "gapm_le.h"
#include "gapm_le_adv.h"
#include "co_buf.h"
#include "prf.h"
#include "gatt_db.h"
#include "gatt_srv.h"

#include "appl_shell.h"
#include <alif/bluetooth/bt_adv_data.h>
#include <alif/bluetooth/bt_scan_rsp.h>
#include "gapm_api.h"

LOG_MODULE_DECLARE(main, CONFIG_MAIN_LOG_LEVEL);

static uint8_t hello_arr[] = "HelloHello";
static uint8_t hello_arr_index __attribute__((noinit));

#define BT_CONN_STATE_CONNECTED    0x00
#define BT_CONN_STATE_DISCONNECTED 0x01
/* Service Definitions */
#define ATT_128_PRIMARY_SERVICE    ATT_16_TO_128_ARRAY(GATT_DECL_PRIMARY_SERVICE)
#define ATT_128_INCLUDED_SERVICE   ATT_16_TO_128_ARRAY(GATT_DECL_INCLUDE)
#define ATT_128_CHARACTERISTIC     ATT_16_TO_128_ARRAY(GATT_DECL_CHARACTERISTIC)
#define ATT_128_CLIENT_CHAR_CFG    ATT_16_TO_128_ARRAY(GATT_DESC_CLIENT_CHAR_CFG)
/* HELLO SERVICE and attribute 128 bit UUIDs */
#define HELLO_UUID_128_SVC                                                                         \
	{0x12, 0x34, 0x56, 0x78, 0x90, 0x12, 0x23, 0x34,                                           \
	 0x45, 0x56, 0x67, 0x78, 0x89, 0x90, 0x00, 0x00}
#define HELLO_UUID_128_CHAR0                                                                       \
	{0x12, 0x34, 0x56, 0x78, 0x90, 0x12, 0x23, 0x34,                                           \
	 0x45, 0x56, 0x67, 0x78, 0x89, 0x15, 0x00, 0x00}
#define HELLO_UUID_128_CHAR1                                                                       \
	{0x12, 0x34, 0x56, 0x78, 0x90, 0x12, 0x23, 0x34,                                           \
	 0x45, 0x56, 0x67, 0x78, 0x89, 0x16, 0x00, 0x00}
#define HELLO_METAINFO_CHAR0_NTF_SEND 0x4321
#define ATT_16_TO_128_ARRAY(uuid)                                                                  \
	{(uuid) & 0xFF, (uuid >> 8) & 0xFF, 0, 0, 0, 0, 0, 0, 0, 0, 0, 0, 0, 0, 0, 0}

/* List of attributes in the service */
enum service_att_list {
	HELLO_IDX_SERVICE = 0,
	/* First characteristic is readable + supports notifications */
	HELLO_IDX_CHAR0_CHAR,
	HELLO_IDX_CHAR0_VAL,
	HELLO_IDX_CHAR0_NTF_CFG,
	/* Second characteristic is writable */
	HELLO_IDX_CHAR1_CHAR,
	HELLO_IDX_CHAR1_VAL,
	/* Number of items*/
	HELLO_IDX_NB,
};

static volatile uint8_t conn_status __attribute__((noinit));
/* Store advertising activity index for re-starting after disconnection */
static volatile uint8_t conn_idx __attribute__((noinit));
static uint8_t adv_actv_idx __attribute__((noinit));
static struct service_env env __attribute__((noinit));

static volatile bool wakeup_status;
static volatile int run_profile_error;

static const char *device_name = app_shell_device_name;

/* Service UUID to pass into gatt_db_svc_add */
static const uint8_t hello_service_uuid[] = HELLO_UUID_128_SVC;

/* GATT database for the service */
static const gatt_att_desc_t hello_att_db[HELLO_IDX_NB] = {
	[HELLO_IDX_SERVICE] = {ATT_128_PRIMARY_SERVICE, ATT_UUID(16) | PROP(RD), 0},

	[HELLO_IDX_CHAR0_CHAR] = {ATT_128_CHARACTERISTIC, ATT_UUID(16) | PROP(RD), 0},
	[HELLO_IDX_CHAR0_VAL] = {HELLO_UUID_128_CHAR0, ATT_UUID(128) | PROP(RD) | PROP(N),
				 OPT(NO_OFFSET)},
	[HELLO_IDX_CHAR0_NTF_CFG] = {ATT_128_CLIENT_CHAR_CFG, ATT_UUID(16) | PROP(RD) | PROP(WR),
				     0},

	[HELLO_IDX_CHAR1_CHAR] = {ATT_128_CHARACTERISTIC, ATT_UUID(16) | PROP(RD), 0},
	[HELLO_IDX_CHAR1_VAL] = {HELLO_UUID_128_CHAR1, ATT_UUID(128) | PROP(WR),
				 OPT(NO_OFFSET) | sizeof(uint16_t)},
};

/**
 * Bluetooth stack configuration
 */
static gapm_config_t gapm_cfg = {
	.role = GAP_ROLE_LE_PERIPHERAL,
	.pairing_mode = GAPM_PAIRING_DISABLE,
	.privacy_cfg = 0,
	.renew_dur = 1500,
	.private_identity.addr = {0xCF, 0xFE, 0xFB, 0xDE, 0x11, 0x07},
	.irk.key = {0, 0, 0, 0, 0, 0, 0, 0, 0, 0, 0, 0, 0, 0, 0, 0},
	.gap_start_hdl = 0,
	.gatt_start_hdl = 0,
	.att_cfg = 0,
	.sugg_max_tx_octets = GAP_LE_MAX_OCTETS,
	.sugg_max_tx_time = GAP_LE_MAX_TIME,
	.tx_pref_phy = GAP_PHY_ANY,
	.rx_pref_phy = GAP_PHY_ANY,
	.tx_path_comp = 0,
	.rx_path_comp = 0,
	.class_of_device = 0,  /* BT Classic only */
	.dflt_link_policy = 0, /* BT Classic only */
};

/* Environment for the service */
struct service_env {
	uint16_t start_hdl;
	uint8_t user_lid;
	uint8_t char0_val[250];
	uint8_t char1_val;
	volatile bool ntf_ongoing;
	volatile uint16_t ntf_cfg;
};

static gapc_le_con_param_nego_with_ce_len_t preferred_connection_param = {.ce_len_min = 5,
									  .ce_len_max = 10,
									  .hdr.interval_min = 0,
									  .hdr.interval_max = 10,
									  .hdr.latency = 0,
									  .hdr.sup_to = 800};

/* function headers */
static uint16_t service_init(void);

/* Functions */

/**
 * Bluetooth GAPM callbacks
 */
void on_gapc_proc_cmp_cb(uint8_t conidx, uint32_t metainfo, uint16_t status)
{
	LOG_INF("%s conn:%d status:%d\n", __func__, conidx, status);
}

static void on_le_connection_req(uint8_t conidx, uint32_t metainfo, uint8_t actv_idx, uint8_t role,
				 const gap_bdaddr_t *p_peer_addr,
				 const gapc_le_con_param_t *p_con_params, uint8_t clk_accuracy)
{
	LOG_DBG("Connection request on index %u", conidx);
	gapc_le_connection_cfm(conidx, 0, NULL);

	LOG_INF("Connection parameters: interval %u, latency %u, supervision timeout %u",
		p_con_params->interval, p_con_params->latency, p_con_params->sup_to);

	LOG_DBG("Peer BD address %02X:%02X:%02X:%02X:%02X:%02X (conidx: %u)", p_peer_addr->addr[5],
		p_peer_addr->addr[4], p_peer_addr->addr[3], p_peer_addr->addr[2],
		p_peer_addr->addr[1], p_peer_addr->addr[0], conidx);

	conn_status = BT_CONN_STATE_CONNECTED;
	conn_idx = conidx;
	printk("BLE Connected conn: %d\n", conidx);

	gapc_le_update_params(conidx, 0, &preferred_connection_param, on_gapc_proc_cmp_cb);

	LOG_INF("Please enable notifications on peer device..");
}

static void on_key_received(uint8_t conidx, uint32_t metainfo, const gapc_pairing_keys_t *p_keys)
{
	LOG_WRN("Unexpected key received key on conidx %u", conidx);
}

static void on_disconnection(uint8_t conidx, uint32_t metainfo, uint16_t reason)
{
	uint16_t err;

	LOG_DBG("Connection index %u disconnected for reason %u", conidx, reason);

	err = bt_gapm_advertisement_continue(conidx);
	if (err) {
		LOG_ERR("Error restarting advertising: %u", err);
	} else {
		LOG_DBG("Restarting advertising");
	}

	conn_status = BT_CONN_STATE_DISCONNECTED;
	conn_idx = GAP_INVALID_CONIDX;
	LOG_INF("BLE disconnected conn:%d. Waiting new connection", conidx);
}

static void on_name_get(uint8_t conidx, uint32_t metainfo, uint16_t token, uint16_t offset,
			uint16_t max_len)
{
	LOG_WRN("Received unexpected name get from conidx: %u", conidx);
}

static void on_appearance_get(uint8_t conidx, uint32_t metainfo, uint16_t token)
{
	/* Send 'unknown' appearance */
	LOG_DBG("%s", __func__);
	gapc_le_get_appearance_cfm(conidx, token, GAP_ERR_NO_ERROR, 0);
}

static void on_pref_param_get(uint8_t conidx, uint32_t metainfo, uint16_t token)
{

	gapc_le_preferred_periph_param_t prefs = {
		.con_intv_min = preferred_connection_param.hdr.interval_min,
		.con_intv_max = preferred_connection_param.hdr.interval_max,
		.latency = preferred_connection_param.hdr.latency,
		.conn_timeout = 3200 * 2,
	};
	LOG_DBG("%s", __func__);

	gapc_le_get_preferred_periph_params_cfm(conidx, token, GAP_ERR_NO_ERROR, prefs);
}

void on_bond_data_updated(uint8_t conidx, uint32_t metainfo, const gapc_bond_data_updated_t *p_data)
{
	LOG_DBG("%s", __func__);
}
void on_auth_payload_timeout(uint8_t conidx, uint32_t metainfo)
{
	LOG_DBG("%s", __func__);
}
void on_no_more_att_bearer(uint8_t conidx, uint32_t metainfo)
{
	LOG_DBG("%s", __func__);
}
void on_cli_hash_info(uint8_t conidx, uint32_t metainfo, uint16_t handle, const uint8_t *p_hash)
{
	LOG_DBG("%s", __func__);
}
void on_name_set(uint8_t conidx, uint32_t metainfo, uint16_t token, co_buf_t *p_buf)
{
	LOG_DBG("%s", __func__);
	gapc_le_set_name_cfm(conidx, token, GAP_ERR_NO_ERROR);
}
void on_appearance_set(uint8_t conidx, uint32_t metainfo, uint16_t token, uint16_t appearance)
{
	LOG_DBG("%s", __func__);
	gapc_le_set_appearance_cfm(conidx, token, GAP_ERR_NO_ERROR);
}

static const gapc_connection_req_cb_t gapc_con_cbs = {
	.le_connection_req = on_le_connection_req,
};

static const gapc_security_cb_t gapc_sec_cbs = {
	.key_received = on_key_received,
	/* All other callbacks in this struct are optional */
};

static const gapc_connection_info_cb_t gapc_con_inf_cbs = {
	.disconnected = on_disconnection,
	.name_get = on_name_get,
	.appearance_get = on_appearance_get,
	.slave_pref_param_get = on_pref_param_get,
	/* Other callbacks in this struct are optional */
	.bond_data_updated = on_bond_data_updated,
	.auth_payload_timeout = on_auth_payload_timeout,
	.no_more_att_bearer = on_no_more_att_bearer,
	.cli_hash_info = on_cli_hash_info,
	.name_set = on_name_set,
	.appearance_set = on_appearance_set,
};

void on_param_update_req(uint8_t conidx, uint32_t metainfo, const gapc_le_con_param_nego_t *p_param)
{
	LOG_DBG("%s:%d", __func__, conidx);
	gapc_le_update_params_cfm(conidx, true, preferred_connection_param.ce_len_min,
				  preferred_connection_param.ce_len_max);
}
void on_param_updated(uint8_t conidx, uint32_t metainfo, const gapc_le_con_param_t *p_param)
{
	LOG_DBG("%s conn:%d", __func__, conidx);
}
void on_packet_size_updated(uint8_t conidx, uint32_t metainfo, uint16_t max_tx_octets,
			    uint16_t max_tx_time, uint16_t max_rx_octets, uint16_t max_rx_time)
{
	LOG_DBG("%s conn:%d max_tx_octets:%d max_tx_time:%d  max_rx_octets:%d "
		"max_rx_time:%d",
		__func__, conidx, max_tx_octets, max_tx_time, max_rx_octets, max_rx_time);

	/* PeHo: Seppo why this is done here? */
	const uint16_t ret =
		gapc_le_update_params(conidx, 0, &preferred_connection_param, on_gapc_proc_cmp_cb);

	LOG_INF("Update connection %u ret:%d\n", conidx, ret);
}

void on_phy_updated(uint8_t conidx, uint32_t metainfo, uint8_t tx_phy, uint8_t rx_phy)
{
	LOG_DBG("%s conn:%d tx_phy:%d rx_phy:%d", __func__, conidx, tx_phy, rx_phy);
}
void on_subrate_updated(uint8_t conidx, uint32_t metainfo,
			const gapc_le_subrate_t *p_subrate_params)
{
	LOG_DBG("%s conn:%d", __func__, conidx);
}
/* All callbacks in this struct are optional */
static const gapc_le_config_cb_t gapc_le_cfg_cbs = {
	.param_update_req = on_param_update_req,
	.param_updated = on_param_updated,
	.packet_size_updated = on_packet_size_updated,
	.phy_updated = on_phy_updated,
	.subrate_updated = on_subrate_updated,
};

static void on_gapm_err(uint32_t metainfo, uint8_t code)
{
	LOG_ERR("gapm error %d", code);
}
static const gapm_cb_t gapm_err_cbs = {
	.cb_hw_error = on_gapm_err,
};

static const gapm_callbacks_t gapm_cbs = {
	.p_con_req_cbs = &gapc_con_cbs,
	.p_sec_cbs = &gapc_sec_cbs,
	.p_info_cbs = &gapc_con_inf_cbs,
	.p_le_config_cbs = &gapc_le_cfg_cbs,
	.p_bt_config_cbs = NULL, /* BT classic so not required */
	.p_gapm_cbs = &gapm_err_cbs,
};

void app_connection_status_update(enum gapm_connection_event con_event, uint8_t con_idx,
				  uint16_t status)
{
	switch (con_event) {
	case GAPM_API_SEC_CONNECTED_KNOWN_DEVICE:
		conn_status = true;
		break;
	case GAPM_API_DEV_CONNECTED:
		conn_status = true;
		break;
	case GAPM_API_DEV_DISCONNECTED:
		LOG_INF("Client disconnected (conidx: %u), restating advertising", con_idx);

		conn_status = false;
		LOG_INF("BLE disconnected conn:%d. Waiting new connection", con_idx);
		break;
	case GAPM_API_PAIRING_FAIL:
		LOG_INF("Connection pairing index %u fail for reason %u", con_idx, status);
		break;
	}
}

static gapm_user_cb_t gapm_user_cb = {
	.connection_status_update = app_connection_status_update,
};

static uint16_t set_advertising_data(uint8_t actv_idx)
{
	bt_adv_data_set_name_auto(device_name, strlen(device_name));

	return bt_gapm_advertiment_data_set(actv_idx);
}

static uint16_t set_scan_data(uint8_t actv_idx)
{
	int ret;

	/* gatt service identifier */
	uint16_t svc[8] = {0xd123, 0xeabc, 0x785f, 0x1523, 0xefde, 0x1212, 0x1523, 0x0000};

	ret = bt_scan_rsp_set_tlv(GAP_AD_TYPE_COMPLETE_LIST_128_BIT_UUID, svc, sizeof(svc));
	if (ret) {
		LOG_ERR("Scan response UUID set fail %d", ret);
		return ATT_ERR_INSUFF_RESOURCE;
	}

	ret = bt_scan_rsp_data_set_name_auto(device_name, strlen(device_name));

	if (ret) {
		LOG_ERR("Scan response device name data fail %d", ret);
		return ATT_ERR_INSUFF_RESOURCE;
	}

	return bt_gapm_scan_response_set(actv_idx);
}

static uint16_t create_advertising(void)
{
	gapm_le_adv_create_param_t adv_create_params = {
		.prop = GAPM_ADV_PROP_UNDIR_CONN_MASK,
		.disc_mode = GAPM_ADV_MODE_GEN_DISC,
		.tx_pwr = 0,
		.filter_pol = GAPM_ADV_ALLOW_SCAN_ANY_CON_ANY,
		.prim_cfg = {
				.adv_intv_min = ble_adv_int_min,
				.adv_intv_max = ble_adv_int_max,
				.ch_map = ADV_ALL_CHNLS_EN,
				.phy = GAPM_PHY_TYPE_LE_1M,
			},
	};

	return bt_gapm_le_create_advertisement_service(GAPM_STATIC_ADDR, &adv_create_params, NULL,
						       &adv_actv_idx);
}

/* Add service to the stack */
static void server_configure(void)
{
	uint16_t err;

	err = service_init();

	if (err) {
		LOG_ERR("Error %u adding profile", err);
	}
}

/* Service callbacks */
static void on_att_read_get(uint8_t conidx, uint8_t user_lid, uint16_t token, uint16_t hdl,
			    uint16_t offset, uint16_t max_length)
{
	co_buf_t *p_buf = NULL;
	uint16_t status = GAP_ERR_NO_ERROR;
	uint16_t att_val_len = 0;
	void *att_val = NULL;

	do {
		if (offset != 0) {
			/* Long read not supported for any characteristics within this service */
			status = ATT_ERR_INVALID_OFFSET;
			break;
		}

		uint8_t att_idx = hdl - env.start_hdl;

		switch (att_idx) {
		case HELLO_IDX_CHAR0_VAL:
			att_val_len = CONFIG_DATA_STRING_LENGTH;
			uint8_t loop_count = (CONFIG_DATA_STRING_LENGTH / 5);

			if (CONFIG_DATA_STRING_LENGTH % 5) {
				loop_count += 1;
			}
			for (int i = 0; i < loop_count; i++) {
				memcpy(env.char0_val + i * 5, &hello_arr[hello_arr_index], 5);
			}
			att_val = env.char0_val;
			LOG_DBG("read hello text");
			break;

		case HELLO_IDX_CHAR0_NTF_CFG:
			att_val_len = sizeof(env.ntf_cfg);
			att_val = (void *)&env.ntf_cfg;
			break;

		default:
			break;
		}

		if (att_val == NULL) {
			status = ATT_ERR_REQUEST_NOT_SUPPORTED;
			break;
		}

		status = co_buf_alloc(&p_buf, GATT_BUFFER_HEADER_LEN, att_val_len,
				      GATT_BUFFER_TAIL_LEN);
		if (status != CO_BUF_ERR_NO_ERROR) {
			status = ATT_ERR_INSUFF_RESOURCE;
			break;
		}

		memcpy(co_buf_data(p_buf), att_val, att_val_len);
	} while (0);

	/* Send the GATT response */
	gatt_srv_att_read_get_cfm(conidx, user_lid, token, status, att_val_len, p_buf);
	if (p_buf != NULL) {
		co_buf_release(p_buf);
	}
}

static void on_att_val_set(uint8_t conidx, uint8_t user_lid, uint16_t token, uint16_t hdl,
			   uint16_t offset, co_buf_t *p_data)
{
	uint16_t status = GAP_ERR_NO_ERROR;

	do {
		if (offset != 0) {
			/* Long write not supported for any characteristics in this service */
			status = ATT_ERR_INVALID_OFFSET;
			break;
		}

		uint8_t att_idx = hdl - env.start_hdl;

		switch (att_idx) {
		case HELLO_IDX_CHAR1_VAL: {
			if (sizeof(env.char1_val) != co_buf_data_len(p_data)) {
				LOG_DBG("Incorrect buffer size");
				status = ATT_ERR_INVALID_ATTRIBUTE_VAL_LEN;
			} else {
				memcpy(&env.char1_val, co_buf_data(p_data), sizeof(env.char1_val));
				LOG_DBG("TOGGLE LED, state %d", env.char1_val);
			}
			break;
		}

		case HELLO_IDX_CHAR0_NTF_CFG: {
			if (sizeof(uint16_t) != co_buf_data_len(p_data)) {
				LOG_DBG("Incorrect buffer size");
				status = ATT_ERR_INVALID_ATTRIBUTE_VAL_LEN;
			} else {
				uint16_t cfg;

				memcpy(&cfg, co_buf_data(p_data), sizeof(uint16_t));
				if (PRF_CLI_START_NTF == cfg || PRF_CLI_STOP_NTFIND == cfg) {
					env.ntf_cfg = cfg;
				} else {
					/* Indications not supported */
					status = ATT_ERR_REQUEST_NOT_SUPPORTED;
				}
			}
			break;
		}

		default:
			status = ATT_ERR_REQUEST_NOT_SUPPORTED;
			break;
		}
	} while (0);

	/* Send the GATT write confirmation */
	gatt_srv_att_val_set_cfm(conidx, user_lid, token, status);
}

static void on_event_sent(uint8_t conidx, uint8_t user_lid, uint16_t metainfo, uint16_t status)
{
	if (metainfo == HELLO_METAINFO_CHAR0_NTF_SEND) {
		env.ntf_ongoing = false;
	}
}

static const gatt_srv_cb_t gatt_cbs = {
	.cb_att_event_get = NULL,
	.cb_att_info_get = NULL,
	.cb_att_read_get = on_att_read_get,
	.cb_att_val_set = on_att_val_set,
	.cb_event_sent = on_event_sent,
};

/*
 * Service functions
 */
static uint16_t service_init(void)
{
	uint16_t status;

	/* Register a GATT user */
	status = gatt_user_srv_register(CFG_MAX_LE_MTU, 0, &gatt_cbs, &env.user_lid);
	if (status != GAP_ERR_NO_ERROR) {
		return status;
	}

	/* Add the GATT service */
	status = gatt_db_svc_add(env.user_lid, SVC_UUID(128), hello_service_uuid, HELLO_IDX_NB,
				 NULL, hello_att_db, HELLO_IDX_NB, &env.start_hdl);
	if (status != GAP_ERR_NO_ERROR) {
		gatt_user_unregister(env.user_lid);
		return status;
	}

	return GAP_ERR_NO_ERROR;
}

static uint16_t service_notification_send(uint32_t conidx_mask)
{
	co_buf_t *p_buf;
	uint16_t status;
	uint8_t conidx = 0;

	ARG_UNUSED(conidx_mask);

	/* Cannot send another notification unless previous one is completed */
	if (env.ntf_ongoing) {
		return PRF_ERR_REQ_DISALLOWED;
	}

	/* Check notification subscription */
	if (env.ntf_cfg != PRF_CLI_START_NTF) {
		return PRF_ERR_NTF_DISABLED;
	}

	/* Get a buffer to put the notification data into */
	status = co_buf_alloc(&p_buf, GATT_BUFFER_HEADER_LEN, CONFIG_DATA_STRING_LENGTH,
			      GATT_BUFFER_TAIL_LEN);
	if (status != CO_BUF_ERR_NO_ERROR) {
		return GAP_ERR_INSUFF_RESOURCES;
	}

	uint8_t const loop_count = ((CONFIG_DATA_STRING_LENGTH + 4) / 5);

	for (int i = 0; i < loop_count; i++) {
		memcpy(env.char0_val + i * 5, &hello_arr[hello_arr_index], 5);
	}

	memcpy(co_buf_data(p_buf), env.char0_val, CONFIG_DATA_STRING_LENGTH);
	hello_arr_index++;
	if (hello_arr_index > 4) {
		hello_arr_index = 0;
	}

	status = gatt_srv_event_send(conidx, env.user_lid, HELLO_METAINFO_CHAR0_NTF_SEND,
				     GATT_NOTIFY, env.start_hdl + HELLO_IDX_CHAR0_VAL, p_buf);

	co_buf_release(p_buf);

	if (status == GAP_ERR_NO_ERROR) {
		env.ntf_ongoing = true;
	}

	return status;
}

int ble_init(void)
{
	/* Update preferred connection parameters */
	preferred_connection_param.hdr.interval_min = ble_conn_int_min;
	preferred_connection_param.hdr.interval_max = ble_conn_int_max;

	/* Start up bluetooth host stack. */
	uint16_t ble_status = alif_ble_enable(NULL);

	if (ble_status == 0) {
		uint16_t rc;
		/* BLE initialized first time */
		hello_arr_index = 0;
		conn_idx = GAP_INVALID_CONIDX;
		memset(&env, 0, sizeof(struct service_env));
		conn_status = BT_CONN_STATE_DISCONNECTED;

		/* Generate random address */
		se_service_get_rnd_num(&gapm_cfg.private_identity.addr[3], 3);
		/* Configure Bluetooth Stack */
		LOG_INF("Init gapm service");
		rc = bt_gapm_init(&gapm_cfg, &gapm_user_cb, device_name, strlen(device_name));
		if (rc) {
			LOG_ERR("gapm_configure error %u", rc);
			return -1;
		}

		server_configure();

		/* Create an advertising activity */
		rc = create_advertising();
		if (rc) {
			LOG_ERR("Advertisement create fail %u", rc);
			return -1;
		}

		rc = set_advertising_data(adv_actv_idx);
		if (rc) {
			LOG_ERR("Advertisement data set fail %u", rc);
			return -1;
		}

		rc = set_scan_data(adv_actv_idx);
		if (rc) {
			LOG_ERR("Scan response data set fail %u", rc);
			return -1;
		}

		rc = bt_gapm_advertisement_start(adv_actv_idx);
		if (rc) {
			LOG_ERR("Advertisement start fail %u", rc);
			return -1;
		}

		LOG_INF("Init complete!");
	}

	if (ble_status && ble_status != -EALREADY) {
		LOG_ERR("alif_ble_enable error %d", ble_status);
		return -1;
	}

	return 0;
}

bool ble_is_connected(void)
{
	return conn_status == BT_CONN_STATE_CONNECTED;
}
```

## src/power_shell.c
```c
/* Copyright (C) 2026 Alif Semiconductor - All Rights Reserved.
 * Use, distribution and modification of this code is permitted under the
 * terms stated in the Alif Semiconductor Software License Agreement
 *
 * You should have received a copy of the Alif Semiconductor Software
 * License Agreement with this file. If not, please write to:
 * contact@alifsemi.com, or visit: https://alifsemi.com/license
 */

#include <zephyr/kernel.h>
#include <zephyr/shell/shell.h>
#include <zephyr/shell/shell_uart.h>
#include <zephyr/logging/log.h>
#include <stdlib.h>
#include <se_service.h>

#include "appl_shell.h"
#include "power_mgr.h"
#include "power_shell.h"

extern run_profile_t current_runp;
extern off_profile_t current_offp;
extern int16_t power_profile;

LOG_MODULE_DECLARE(power_shell, CONFIG_MAIN_LOG_LEVEL);

#define APP_RET_MEM_BLOCKS \
	SRAM4_1_MASK | SRAM4_2_MASK | SRAM4_3_MASK | SRAM4_4_MASK | SRAM5_1_MASK | SRAM5_2_MASK |  \
	SRAM5_3_MASK | SRAM5_4_MASK | SRAM5_5_MASK

#if DT_NODE_HAS_COMPAT_STATUS(DT_NODELABEL(rtc0), snps_dw_apb_rtc, okay)
#define WAKEUP_SOURCE         DT_NODELABEL(rtc0)
#define SE_OFFP_EWIC_CFG      EWIC_RTC_A
#define SE_OFFP_WAKEUP_EVENTS WE_LPRTC
#elif DT_NODE_HAS_COMPAT_STATUS(DT_NODELABEL(timer0), snps_dw_timers, okay)
#define WAKEUP_SOURCE         DT_NODELABEL(timer0)
#define SE_OFFP_EWIC_CFG      EWIC_VBAT_TIMER
#define SE_OFFP_WAKEUP_EVENTS WE_LPTIMER0
#else
#error "Wakeup Device not enabled in the dts"
#endif

static int16_t get_power_profile(const char *power_profile)
{
	if (!strcmp(power_profile, "GO_4")) {
		/* GO_4: Only M55-HE running WHILE(1) at 76.8 MHz from HFRC. No NPU is enabled. */
		/* NOTE! No MRAM, must use TCM build */
		/* NOTE! No SYSTOP, must use LPUART */
		current_runp.power_domains = PD_VBAT_AON_MASK | PD_SSE700_AON_MASK;
		current_runp.aon_clk_src = CLK_SRC_LFXO;
		current_runp.run_clk_src = CLK_SRC_HFRC;
		current_runp.cpu_clk_freq = CLOCK_FREQUENCY_76_8_RC_MHZ;
		/* Set RC divider to max 76.8Mhz so CPU is run at requested 76.8Mhz */
		current_runp.scaled_clk_freq = SCALED_FREQ_RC_ACTIVE_76_8_MHZ;
		current_runp.memory_blocks = SERAM_MASK | BACKUP4K_MASK;
		current_runp.phy_pwr_gating = 0;
		current_runp.vdd_ioflex_3V3 = IOFLEX_LEVEL_1V8;
		current_runp.dcdc_voltage = 825;
		current_runp.dcdc_mode = DCDC_MODE_PFM_FORCED;
		return PM_STATE_MODE_GO_4;
	} else if (!strcmp(power_profile, "GO_5")) {
		/* GO_5: Only M55-HE running WHILE(1) at 19.2 MHz from HFRC. No NPU is enabled. */
		/* NOTE! No MRAM, must use TCM build */
		/* NOTE! No SYSTOP, must use LPUART */
		current_runp.power_domains = PD_VBAT_AON_MASK | PD_SSE700_AON_MASK;
		current_runp.aon_clk_src = CLK_SRC_LFXO;
		current_runp.run_clk_src = CLK_SRC_HFRC;
		current_runp.cpu_clk_freq = CLOCK_FREQUENCY_76_8_RC_MHZ;
		/* Set divider to divide max RC 76.8Mhz to 19.2 Mhz */
		current_runp.scaled_clk_freq = SCALED_FREQ_RC_ACTIVE_19_2_MHZ;
		current_runp.memory_blocks = SERAM_MASK | BACKUP4K_MASK;
		current_runp.phy_pwr_gating = 0;
		current_runp.vdd_ioflex_3V3 = IOFLEX_LEVEL_1V8;
		current_runp.dcdc_voltage = 825;
		current_runp.dcdc_mode = DCDC_MODE_PFM_FORCED;
		return PM_STATE_MODE_GO_5;
	} else if (!strcmp(power_profile, "READY_2")) {
		/* READY_2: M55-HE WFI at 76.8 MHz from HFRC. */
		/* NOTE! No MRAM, must use TCM build */
		/* NOTE! No SYSTOP, must use LPUART */
		current_runp.power_domains = PD_VBAT_AON_MASK | PD_SSE700_AON_MASK;
		current_runp.aon_clk_src = CLK_SRC_LFXO;
		current_runp.run_clk_src = CLK_SRC_HFRC;
		current_runp.cpu_clk_freq = CLOCK_FREQUENCY_76_8_RC_MHZ;
		/* Set RC divider to max 76.8Mhz so CPU is run at requested 76.8Mhz */
		current_runp.scaled_clk_freq = SCALED_FREQ_RC_ACTIVE_76_8_MHZ;
		current_runp.memory_blocks = BACKUP4K_MASK;
		current_runp.phy_pwr_gating = 0;
		current_runp.vdd_ioflex_3V3 = IOFLEX_LEVEL_1V8;
		current_runp.dcdc_voltage = 825;
		current_runp.dcdc_mode = DCDC_MODE_PFM_FORCED;
		return PM_STATE_MODE_READY_2;
	/* Rest power states are for Off profile only */
	} else if (!strcmp(power_profile, "IDLE_1")) {
		/* IDLE_1: All CPU cores powered off. 38.4MHz clock from HFXO. */
		current_offp.power_domains   = PD_VBAT_AON_MASK | PD_SSE700_AON_MASK | PD_SYST_MASK;
		current_offp.dcdc_voltage    = 825;
		current_offp.dcdc_mode       = DCDC_MODE_PFM_FORCED;
		current_offp.aon_clk_src     = CLK_SRC_LFXO;
		current_offp.stby_clk_src    = CLK_SRC_HFXO;
		current_offp.stby_clk_freq   = SCALED_FREQ_XO_HIGH_DIV_38_4_MHZ;
		current_offp.memory_blocks   = APP_RET_MEM_BLOCKS | BACKUP4K_MASK;
		current_offp.ewic_cfg        = SE_OFFP_EWIC_CFG;
		/** If CONFIG_FLASH_BASE_ADDRESS is zero application run
		 * from itcm and no MRAM needed
		 */
#if (CONFIG_FLASH_BASE_ADDRESS != 0)
		current_offp.memory_blocks  |= MRAM_MASK;
#endif
		current_offp.phy_pwr_gating  = 0;
		current_offp.vdd_ioflex_3V3  = IOFLEX_LEVEL_1V8;
		current_offp.wakeup_events   = SE_OFFP_WAKEUP_EVENTS;
		current_offp.vtor_address    = SCB->VTOR;
		current_offp.vtor_address_ns = SCB->VTOR;
		return PM_STATE_MODE_IDLE_1;
	} else if (!strcmp(power_profile, "IDLE_2")) {
		return PM_STATE_MODE_IDLE_2;
	} else if (!strcmp(power_profile, "STANDBY_1")) {
		return PM_STATE_MODE_STANDBY_1;
	} else if (!strcmp(power_profile, "STOP_1")) {
		return PM_STATE_MODE_STOP_1;
	} else if (!strcmp(power_profile, "STOP_2")) {
		return PM_STATE_MODE_STOP_2;
	} else if (!strcmp(power_profile, "STOP_3")) {
		return PM_STATE_MODE_STOP_3;
	} else if (!strcmp(power_profile, "STOP_4")) {
		return PM_STATE_MODE_STOP_4;
	} else if (!strcmp(power_profile, "STOP_5")) {
		return PM_STATE_MODE_STOP_5;
	}

	return -1;
}

/**
 * Application command functions
 **/
static int cmd_set_run_cfg(const struct shell *shell, size_t argc, char **argv)
{
	/**
	 * If power profile was defined, set correct params to current_runp
	 * before getting the rest of the params
	 */
	char *pwr_profile = param_get_char(argc, argv, "--power_profile", NULL);

	if (pwr_profile) {
		shell_print(shell, "Using power profile %s\n", pwr_profile);
		power_profile = get_power_profile(pwr_profile);
	}

	current_runp.power_domains = param_get_int(argc, argv, "--power_domains",
		current_runp.power_domains);
	current_runp.dcdc_mode = param_get_int(argc, argv, "--dcdc_mode", current_runp.dcdc_mode);
	current_runp.dcdc_voltage = param_get_int(argc, argv, "--dcdc_voltage",
		current_runp.dcdc_voltage);
	current_runp.aon_clk_src = param_get_int(argc, argv, "--aon_clk_src",
		current_runp.aon_clk_src);
	current_runp.run_clk_src = param_get_int(argc, argv, "--run_clk_src",
		current_runp.run_clk_src);
	current_runp.cpu_clk_freq = param_get_int(argc, argv, "--cpu_clk_freq",
		current_runp.cpu_clk_freq);
	current_runp.scaled_clk_freq = param_get_int(argc, argv, "--scaled_clk_freq",
		current_runp.scaled_clk_freq);
	current_runp.memory_blocks = param_get_int(argc, argv, "--memory_blocks",
		current_runp.memory_blocks);
	current_runp.phy_pwr_gating = param_get_int(argc, argv, "--phy_pwr_gating",
		current_runp.phy_pwr_gating);
	current_runp.vdd_ioflex_3V3 = param_get_int(argc, argv, "--vdd_ioflex_3V3",
		current_runp.vdd_ioflex_3V3);

	int ret = se_service_set_run_cfg(&current_runp);

	if (ret) {
		LOG_ERR("SE: set_run_cfg failed = %d", ret);
	}

	shell_print(shell, "run_cfg: power_domains = 0x%08" PRIX32 ", dcdc_voltage = %" PRIu32
		", aon_clk_src = %" PRIu32 ", run_clk_src = %" PRIu32 ", cpu_clk_freq = %" PRIu32
		", scaled_clk_freq = %" PRIu32 "\n"
		"         memory_blocks = 0x%08" PRIX32 ", dcdc_mode = %" PRIu32
		", phy_pwr_gating = %" PRIu32 ", vdd_ioflex_3V3 = %" PRIu32 "\n"
		"         error_code = %" PRIu32 ", ret = %" PRIu32 "\n",
		current_runp.power_domains, current_runp.dcdc_voltage, current_runp.aon_clk_src,
		current_runp.run_clk_src, current_runp.cpu_clk_freq, current_runp.scaled_clk_freq,
		current_runp.memory_blocks, current_runp.dcdc_mode, current_runp.phy_pwr_gating,
		current_runp.vdd_ioflex_3V3, ret, ret);
}

static int cmd_set_off_cfg(const struct shell *shell, size_t argc, char **argv)
{
	/**
	 * If power profile was defined, set correct params to offp
	 * before getting the rest of the params
	 */
	char *pwr_profile = param_get_char(argc, argv, "--power_profile", NULL);

	if (pwr_profile) {
		shell_print(shell, "Using power profile %s\n", pwr_profile);
		power_profile = get_power_profile(pwr_profile);
	}

	current_offp.power_domains = param_get_int(argc, argv, "--power_domains",
		current_offp.power_domains);
	current_offp.dcdc_mode = param_get_int(argc, argv, "--dcdc_mode",
		current_offp.dcdc_mode);
	current_offp.dcdc_voltage = param_get_int(argc, argv, "--dcdc_voltage",
		current_offp.dcdc_voltage);
	current_offp.aon_clk_src = param_get_int(argc, argv, "--aon_clk_src",
		current_offp.aon_clk_src);
	current_offp.stby_clk_src = param_get_int(argc, argv, "--stby_clk_src",
		current_offp.stby_clk_src);
	current_offp.stby_clk_freq = param_get_int(argc, argv, "--stby_clk_freq",
		current_offp.stby_clk_freq);
	current_offp.memory_blocks = param_get_int(argc, argv, "--memory_blocks",
		current_offp.memory_blocks);
	current_offp.phy_pwr_gating = param_get_int(argc, argv, "--phy_pwr_gating",
		current_offp.phy_pwr_gating);
	current_offp.vdd_ioflex_3V3 = param_get_int(argc, argv, "--vdd_ioflex_3V3",
		current_offp.vdd_ioflex_3V3);

	current_offp.wakeup_events = param_get_int(argc, argv, "--wakeup_events",
		current_offp.wakeup_events);
	current_offp.ewic_cfg = param_get_int(argc, argv, "--ewic_cfg", current_offp.ewic_cfg);
	current_offp.vtor_address = param_get_int(argc, argv, "--vtor_address",
		current_offp.vtor_address);
	current_offp.vtor_address_ns = param_get_int(argc, argv, "--vtor_address_ns",
		current_offp.vtor_address_ns);

	int ret = set_current_off_profile();

	if (ret) {
		LOG_ERR("SE: set_off_cfg failed = %d", ret);
	}

	shell_print(shell, "off_cfg: power_domains = 0x%08" PRIX32 ", dcdc_voltage = %" PRIu32
		", dcdc_mode = %" PRIu32 ", aon_clk_src = %" PRIu32 ", stby_clk_src = %" PRIu32
		", stby_clk_freq = %" PRIu32 "\n         memory_blocks = 0x%08" PRIX32
		", phy_pwr_gating = %" PRIu32 ", vdd_ioflex_3V3 = %" PRIu32
		", wakeup_events = 0x%08" PRIX32 ", ewic_cfg = 0x%08" PRIX32
		", vtor_address = 0x%08" PRIX32 "\n         vtor_address_ns = 0x%08" PRIX32
		", error_code = %" PRIu32 ", ret = %" PRIu32 "\n",
		current_offp.power_domains, current_offp.dcdc_voltage, current_offp.dcdc_mode,
		current_offp.aon_clk_src, current_offp.stby_clk_src, current_offp.stby_clk_freq,
		current_offp.memory_blocks, current_offp.phy_pwr_gating,
		current_offp.vdd_ioflex_3V3, current_offp.wakeup_events, current_offp.ewic_cfg,
		current_offp.vtor_address, current_offp.vtor_address_ns, ret, ret);

	return ret;
}

#define SET_RUN_HELP "set_run_cfg --power_profile <optional profile> --power_domains" \
" <pwr domains in hex> --dcdc_voltage <750 - 850>\n --dcdc_mode <...> --aon_clk_src " \
"<LFRC = 0, LFXO = 1> --run_clk_src <HFRC = 0, HFXO = 1, PLL = 2>\n" \
"--cpu_clk_freq <core freq, see clock_frequency_t> --scaled_clk_freq <scaled_clk_freq_t>\n" \
"--memory_blocks <memory blocks in hex> --phy_pwr_gating <...> --vdd_ioflex_3V3 " \
"<3V3 = 0, 1V8 0 1 (ioflex_mode_t)>\n" \
"See more details from file aipm.h"

#define SET_OFF_HELP "set_off_cfg --power_profile <optional profile> --power_domains " \
"<pwr domains in hex> --dcdc_voltage <750 - 850>\n --dcdc_mode <...>  --aon_clk_src " \
"<LFRC = 0, LFXO = 1> --stby_clk_src <HFRC = 0, HFXO = 1, PLL = 2>\n" \
"--stby_clk_freq < core freq, see clock_frequency_t> --memory_blocks < memory blocks in hex>\n" \
"--phy_pwr_gating <...> --vdd_ioflex_3V3 <3V3 = 0, 1V8 0 1 (ioflex_mode_t)> --wakeup_events" \
"<hex value>\n --ewic_cfg <hex value> --vtor_address <vtor addr in hex> --vtor_address_ns" \
"<vtor addr_ns in hex>\n" \
"See more details from aipm.h"

SHELL_STATIC_SUBCMD_SET_CREATE(
	power_sub_cmds,
	SHELL_CMD_ARG(set_run_cfg, NULL, SET_RUN_HELP, cmd_set_run_cfg, 0, 0),
	SHELL_CMD_ARG(set_off_cfg, NULL, SET_OFF_HELP, cmd_set_off_cfg, 0, 0),
	SHELL_SUBCMD_SET_END);
SHELL_CMD_REGISTER(senc, &power_sub_cmds, "Ble power configuration commands", NULL);
```
